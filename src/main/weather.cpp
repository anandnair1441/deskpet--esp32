#include "weather.h"
#include <HTTPClient.h>
#include <Arduino_JSON.h>
#include <time.h>
#include "s.h"


float temperature = 0.0;
float feelsLike = 0.0;
int humidity = 0;
float windSpeed = 0.0;
int windDeg = 0;
int scrollX = 0;
String weatherDesc = "Wait...";
String weatherIcon = "01d";
String city = "thiruvananthapuram";
String countryCode = "IN";
String apiKey = "API_KEY";


const unsigned char bmp_rain[] PROGMEM = {0x00,0x00,0x00,0x00,0x00,0x00,0x00,0x00,0x00,0x00,0x00,0x3f,0xf0,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0x00,0x00};

const unsigned char bmp_clear_day[] PROGMEM = {0x00,0x03,0x00,0x00,0x00,0x03,0x00,0x00,0x0c,0x03,0x00,0xc0,0x0c,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0x00,0x00};

const unsigned char bmp_few_clouds_day[] PROGMEM = {0x00,0x00,0x0c,0x00,0x00,0x00,0x00,0x0c,0x00,0x00,0x00,0x0c,0x00,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0xf0,0x00};

const unsigned char bmp_few_clouds_night[] PROGMEM = {0x00, 0x00, 0x00, 0x00, 0x00, 0x00, 0x00, 0x00, 0x00, 0x00, 0x00, 0x00, 0x00,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 0x00, 0x00};
const unsigned char bmp_clouds[] PROGMEM = {0x00,0x07,0xf8,0x00,0x00,0x00,0x07,0xf8,0x00,0x00,0x00,0x18,0x06,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0xf0,0x00};

const unsigned char bmp_clear_night[] PROGMEM =  {0x00, 0x00, 0x00, 0x00, 0x00, 0x00, 0x00, 0x00, 0x00, 0x00, 0x00, 0x00, 0x00,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 0x00, 0x00};
const unsigned char bmp_mist[] PROGMEM = {0x00,0x00,0x00,0x00,0x00,0x00,0x00,0x00,0x00,0x00,0x00,0x00,0x00,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0x00,0x00};

const unsigned char bmp_thunderstorm[] PROGMEM = {0x00,0x00,0x00,0x00,0x00,0x00,0x00,0x00,0x00,0x00,0x00,0x3f,0xf0,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0x00,0x00};

const unsigned char mini_rain[] PROGMEM = {0x0e,0x00,0x11,0x00,0x20,0x80,0x00,0x60,0x80,0x10,0x80,0x08,0x7f,0xf0,0x04,0x80,0x49,0x20,0xa5,0x40,0x48,0x00,0x02,0x00};

const unsigned char mini_cloud[] PROGMEM = { 0x00, 0x00, 0x00, 0x00, 0x01, 0xc0, 0x07, 0xe0, 0x0f, 0xf0, 0x1f, 0xf8, 0x1f, 0xf8, 0x3f, 0xfc, 0x3f, 0xfc, 0x7f, 0xfe, 0x3f, 0xfe, 0x1f, 0xfc, 0x0f, 0xf0, 0x00, 0x00, 0x00, 0x00, 0x00, 0x00 };

const unsigned char mini_sun[] PROGMEM = {0x01,0x00,0x21,0x08,0x10,0x10,0x03,0x80,0x8f,0xe2,0x4f,0xe4,0x1f,0xf0,0x1f,0xf0,0x1f,0xf0,0x4f,0xe4,0x8f,0xe2,0x03,0x80,0x10,0x10,0x21,0x08,0x01,0x00,0x00,0x00};

ForecastDay fcast[3];
String getWindDir(int deg){
    if(deg >= 337 || deg < 23)  return "N";
    if(deg < 68)                return "NE";
    if(deg < 113)               return "E";
    if(deg < 158)               return "SE";
    if(deg < 203)               return "S";
    if(deg < 248)               return "SW";
    if(deg < 293)               return "W";
    return "NW";
}

void fetchWeather(){
    if(WiFi.status() != WL_CONNECTED) return;
    HTTPClient http;

    // current weather
    String url = "http://api.openweathermap.org/data/2.5/weather?q="
                 + city + "," + countryCode
                 + "&appid=" + apiKey + "&units=metric";
    http.begin(url);
    if(http.GET() == 200){
        JSONVar obj = JSON.parse(http.getString());
        temperature  = double(obj["main"]["temp"]);
        feelsLike    = double(obj["main"]["feels_like"]);
        humidity     = int(obj["main"]["humidity"]);
        weatherDesc  = (const char*)obj["weather"][0]["description"];
        weatherIcon = (const char*)obj["weather"][0]["icon"];
        windSpeed    = double(obj["wind"]["speed"]);
        windDeg      = int(obj["wind"]["deg"]);
    }
    http.end();

    // forecast
    url = "http://api.openweathermap.org/data/2.5/forecast?q="
          + city + "," + countryCode
          + "&appid=" + apiKey + "&units=metric";
    http.begin(url);
    if(http.GET() == 200){
        JSONVar fo = JSON.parse(http.getString());
        struct tm t;
        getLocalTime(&t);
        const char* days[] = {"Sun","Mon","Tue","Wed","Thu","Fri","Sat"};
        int indices[3] = {7, 15, 23};
        for(int i = 0; i < 3; i++){
            fcast[i].temp     = (int)double(fo["list"][indices[i]]["main"]["temp"]);
            fcast[i].icon = (const char*)fo["list"][indices[i]]["weather"][0]["icon"];
            fcast[i].dayName  = days[(t.tm_wday + i + 1) % 7];
        }
    }
    http.end();
}


void drawWeather(){
    // city name
    display.setTextSize(1);
    display.setCursor(0, 0);
    String c = city;
    c.toUpperCase();
    String cityLine = c + "." + countryCode;
    display.print(cityLine);

    if      (weatherIcon == "01d") display.drawBitmap(93, 12, bmp_clear_day,         32, 32, SSD1306_WHITE);
    else if (weatherIcon == "01n") display.drawBitmap(93, 12, bmp_clear_night,       32, 32, SSD1306_WHITE);
    else if (weatherIcon == "02d") display.drawBitmap(92, 12, bmp_few_clouds_day,    34, 32, SSD1306_WHITE);
    else if (weatherIcon == "02n") display.drawBitmap(93, 12, bmp_few_clouds_night,  32, 32, SSD1306_WHITE);
    else if (weatherIcon == "03d" || weatherIcon == "03n" || 
             weatherIcon == "04d" || weatherIcon == "04n") display.drawBitmap(92, 12, bmp_clouds, 34, 32, SSD1306_WHITE);
    else if (weatherIcon == "09d" || weatherIcon == "09n" || 
             weatherIcon == "10d" || weatherIcon == "10n") display.drawBitmap(92, 12, bmp_rain,   34, 32, SSD1306_WHITE);
    else if (weatherIcon == "11d" || weatherIcon == "11n") display.drawBitmap(92, 12, bmp_thunderstorm, 34, 32, SSD1306_WHITE);
    else if (weatherIcon == "13d" || weatherIcon == "13n" || 
             weatherIcon == "50d" || weatherIcon == "50n") display.drawBitmap(93, 12, bmp_mist,   32, 32, SSD1306_WHITE);

    // temperature large left
    display.setTextSize(3);
    display.setCursor(0, 22);
    display.print((int)temperature);
    display.setTextSize(1);
    display.print((char)247);

    // humidity 
    display.setCursor(45, 36);
    display.setTextSize(1);
    display.print("HUM:"); 
    display.setCursor(68, 36);
    display.print(humidity);
    display.print("%");

    // feels like below humidity
    display.setCursor(62, 22);
    display.print("~");
    display.print((int)feelsLike);
    display.print((char)247);

    // divider
    display.drawLine(0, 50, 128, 50, SSD1306_WHITE);

    // description left, wind right
    static unsigned long lastScrollTime = 0;
    
    display.setCursor(2, 54);
    String des = weatherDesc;
    des[0] = toupper(des[0]);
    
    if(des.length() > 10){
    
        String desc = des + "    ";

        int textWidth = desc.length() * 6;

        display.fillRect(2, 54, 68, 10, SSD1306_BLACK);

        display.setTextSize(1);
        display.setTextWrap(false);
        display.setCursor(scrollX, 54);
        display.print(desc);

        display.setCursor(scrollX + textWidth, 54);
        display.print(desc);

        display.fillRect(70, 54, 60, 10, SSD1306_BLACK);
        
        if(millis() - lastScrollTime > 30){
            scrollX--;
            lastScrollTime = millis();
            // reset when fully scrolled off left
            if(scrollX <= -textWidth)
            scrollX = 0; 
        }
    }else{
        display.print(des);
    }

    // wind speed and direction right side
    display.setCursor(78, 54);
    display.print((int)(windSpeed * 3.6));
    display.print("kmh ");
    display.print(getWindDir(windDeg));
}

void drawForcast(){ 
    display.fillRect(0, 0, 128, 13, SSD1306_WHITE);
    display.setTextColor(SSD1306_BLACK);
    display.setTextSize(1);
    display.setCursor(40, 3);
    display.print("FORECAST");
    display.setTextColor(SSD1306_WHITE);

    // column dividers
    display.drawLine(42, 13, 42, 64, SSD1306_WHITE);
    display.drawLine(85, 13, 85, 64, SSD1306_WHITE);

    for(int i = 0; i < 3; i++){
        int xStart = i * 43;
        int cx = xStart + 21;

        // day name
        display.setTextSize(1);
        display.setCursor(cx - (fcast[i].dayName.length() * 3), 16);
        display.print(fcast[i].dayName);

        String ic = fcast[i].icon;
        if(ic == "01d" || ic == "01n"){
            display.drawBitmap(cx - 8, 26, mini_sun, 16, 16, SSD1306_WHITE);
        } else if(ic == "09d" || ic == "09n" ||
                  ic == "10d" || ic == "10n" ||
                  ic == "11d" || ic == "11n"){
            display.drawBitmap(cx - 6, 28, mini_rain, 13, 12, SSD1306_WHITE);
        } else {
            display.drawBitmap(cx - 8, 26, mini_cloud, 16, 16, SSD1306_WHITE);  // clouds, mist, snow all → cloud
        }

        // temperature
        display.setTextSize(1);
        int tempX = cx - (fcast[i].temp >= 10 ? 9 : 6);
        display.setCursor(tempX, 46);
        display.print(fcast[i].temp);
        display.print((char)247);
    }
}